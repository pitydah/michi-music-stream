## firmware/components/michi_audio/Kconfig
```kconfig
menu "Michi Music Stream Audio Engine"

    comment "RTP/UDP session engine (MS-07): canonical PCM S16LE 48 kHz stereo (PT 97, 1920-byte payloads), packet jitter buffer, metrics. Non-canonical formats (S24LE, Opus, other PTs) are rejected and counted, never accepted."

    config MICHI_AUDIO_RTP_PT_S16LE
        int "RTP payload type for PCM S16LE"
        default 97
        range 97 97
        help
          Canonical RTP payload type (contract section 2.5): 97.
          The range pins the value to 97 so a stale sdkconfig can
          never build a device that accepts another PT; michi_audio
          init additionally verifies the constant against the code.

    config MICHI_AUDIO_JITTER_MAX_MS
        int "Jitter buffer capacity (ms)"
        default 500
        range 50 2000
        help
          Packet-level jitter buffer capacity, expressed in 10 ms
          packets (500 ms = 50 packets). The per-session payload pool is
          capacity x MICHI_AUDIO_RX_BUF_BYTES in PSRAM, so 500 ms/8192 B
          costs ~400 KB. Larger values absorb longer network stalls at
          the cost of PSRAM and startup latency.

    config MICHI_AUDIO_PREFILL_MS
        int "Jitter buffer prefill before playback (ms)"
        default 80
        range 10 1000
        help
          Audio buffered into the jitter buffer before the session
          starts writing to the pipeline (clamped at runtime to
          MICHI_AUDIO_JITTER_MAX_MS). After every underrun a fixed
          re-prefill of 250 ms (MICHI_AUDIO_REPREFILL_MS) is used,
          independent of this value.

    config MICHI_AUDIO_RX_BUF_BYTES
        int "Session UDP receive buffer size (bytes)"
        default 8192
        range 2048 65535
        help
          Size of the datagram buffer and of each jitter-buffer payload
          slot. Must exceed the canonical 12-byte RTP header + 1920-byte
          payload (michi_audio init verifies it). Datagrams larger than
          this are truncated by recvfrom.

    config MICHI_AUDIO_TASK_STACK_BYTES
        int "Session task stack size (bytes)"
        default 6144
        range 4096 32768
        help
          Stack of the per-session task (socket I/O, RTP parse, jitter
          buffer insert, blocking pipeline writes). The datagram and
          silence buffers live on the heap, not the stack.

endmenu
```

## firmware/components/michi_audio_output/Kconfig
```kconfig
menu "Michi Music Stream Audio"

    config MICHI_AUDIO_RING_BUFFER_KB
        int "Audio ring buffer size (KiB, allocated in PSRAM)"
        default 1024
        range 16 16384
        help
          Size of the SPSC ring between the network/session producer and the
          I2S consumer task. Default 1024 = 1 MB in PSRAM. The 4 MB legacy
          ring (unsynchronized, static) was replaced: 1 MB at 48 kHz/16-bit
          stereo holds ~5.5 s, plenty for network jitter at the current
          validation baseline. Larger values increase jitter tolerance at
          the cost of PSRAM. Changes take effect on the next session start.
          A ring_buffer_kb of 0 in michi_audio_output_config_t selects this
          default (the option is used when the config is 0). The size must
          be a power of two (16..16384 KiB): the ring indices are masked.

endmenu
```

## firmware/components/michi_button/Kconfig
```kconfig
menu "Michi Music Stream Button"

    comment "Deterministic gestures (contract in michi_button_gesture.h): short press (< RECOVERY_PRESS_MS) opens the pairing window; long press (>= RECOVERY_PRESS_MS and < FACTORY_RESET_PRESS_MS) runs recovery ONLY in RECOVERABLE_ERROR; very long press (>= FACTORY_RESET_PRESS_MS) runs the factory reset (armed). Both gestures are ALWAYS available - no choice can build a firmware without the physical factory reset."

    config MICHI_BUTTON_DEBOUNCE_MS
        int "Debounce window (ms)"
        default 30
        range 10 200
        help
          Stable-window debounce: an edge (press/release) is confirmed only
          after the GPIO level stays equal for a full wall-clock window of
          this many milliseconds (measured by the pure debouncer in
          michi_button_debounce.c, fed by the polling task). The poll period
          does NOT gate the window, so POLL >= DEBOUNCE no longer disables
          the debounce. Honest guarantee: a glitch shorter than this window
          is rejected by the single-authority state machine; contacts that
          bounce for longer than the window need a larger value.
          30 ms rejects most contact chatter while preserving clean taps

    config MICHI_BUTTON_MIN_PRESS_MS
        int "Minimum valid press duration (ms)"
        default 50
        range 5 500
        help
          Press durations shorter than this are treated as noise and
          discarded. Default 50 ms is below any intentional human gesture
          but above typical contact chatter. Must be less than
          MICHI_BUTTON_RECOVERY_PRESS_MS.

    config MICHI_BUTTON_PAIRING_HOLD_MS
        int "Pairing hold threshold (ms)"
        default 5000
        range 2000 30000
        help
          Duration the button must be held (without release) before the
          pairing window opens (hold-on-threshold contract, P0-01). The
          action fires at the MOMENT the elapsed time crosses this value,
          not when the button is released. In RECOVERABLE_ERROR state the
          same threshold triggers recovery instead of pairing.
          5000 ms is long enough to avoid accidental triggers.
          Must be < MICHI_BUTTON_FACTORY_WARN_MS.

    config MICHI_BUTTON_FACTORY_WARN_MS
        int "Factory-reset warning threshold (ms)"
        default 10000
        range MICHI_BUTTON_PAIRING_HOLD_MS 60000
        help
          If the button is still held after this duration AND the pairing
          action was NOT fired (gesture not consumed), a visual/audio
          warning is shown indicating that releasing now cancels the press
          but continued holding will trigger a factory reset.
          Must be > PAIRING_HOLD_MS and < FACTORY_RESET_PRESS_MS.

    config MICHI_BUTTON_FACTORY_RESET_PRESS_MS
        int "Factory reset hold threshold (ms)"
        default 15000
        range MICHI_BUTTON_FACTORY_WARN_MS 60000
        help
          Duration the button must be held to trigger factory reset.  Only
          fires if the gesture is NOT already consumed (pairing/recovery did
          not fire earlier in the same press), preventing accidental
          escalation from pairing to reset.  The press must also have
          started at least MICHI_BUTTON_FACTORY_ARM_MS after boot.
          15 s is deliberately above the 10 s warning to give time to
          release.

    config MICHI_BUTTON_FACTORY_ARM_MS
        int "Factory reset arm window (ms)"
        default 10000
        range 0 300000
        help
          A factory reset runs only if the press STARTED at least this many
          milliseconds after boot (measured with esp_timer_get_time()
          against the button init reference). A button held through
          power-on, or a stuck pin, would otherwise confirm a "press" with
          ~0 ms elapsed as soon as the FSM leaves the protected states and
          erase NVS. 0 disables the arm window. Recovery is NOT gated by
          the arm window (a recoverable error right after boot must stay
          recoverable).

    config MICHI_BUTTON_POLL_MS
        int "Debounce task poll period (ms)"
        default 5
        range 1 50
        help
          Sampling period of the debounce task. Each sample is fed to the
          pure single-authority debouncer (michi_button_debounce.c), which
          confirms an edge only after the level is stable for a full
          MICHI_BUTTON_DEBOUNCE_MS wall-clock window; the poll period does
          NOT gate that window (a sub-window bounce is rejected by the
          stable-state machine itself, not by sample counting). The poll
          cadence sets the task's wake rate and the granularity of the
          idle current; 5 ms gives 200 samples/s of a single GPIO read.

    config MICHI_BUTTON_TASK_STACK_BYTES
        int "Debounce task stack (bytes)"
        default 3072
        range 2048 16384
        help
          Stack of the debounce task (ESP-IDF xTaskCreate takes bytes).
          The task polls one GPIO and posts events, so the default is
          generous.

endmenu
```

## firmware/components/michi_display/Kconfig
```kconfig
menu "Michi Music Stream Display"

    config MICHI_DISPLAY_TASK_STACK_BYTES
        int "Display render task stack (bytes)"
        default 4096
        range 2048 16384
        help
          Stack of the render task (ESP-IDF xTaskCreate takes bytes). The
          task draws into the PSRAM framebuffer and flushes it to the panel
          (a full-frame flush is ~65-80 ms at 20 MHz SPI), so the stack also
          covers the esp_lcd draw_bitmap call. Raise it only if a future
          screen needs deeper frames.

    config MICHI_DISPLAY_QUEUE_LEN
        int "Render request queue length (requests)"
        default 4
        range 2 32
        help
          Depth of the FreeRTOS queue between the state observer /
          update_now_playing / request_redraw producers and the render task.
          A request dropped while the queue is full is logged (warn) by the
          producer and sets a pending flag; the task re-renders once more
          after the drain when the flag is set, and the next state change
          re-renders anyway, so a dropped request does not leave the screen
          stale (a drop racing that re-render is covered by the next state
          change).

    config MICHI_DISPLAY_DIAGNOSTICS_ON_BOOT
        bool "Show live hardware diagnostics immediately after boot (lab builds)"
        default n
        help
          For physical bench testing, keep the diagnostics panel on screen
          without relying on a removed pairing button, touchscreen or server.
          Disable in production builds. Errors and firmware OTA safety screens
          still take precedence over diagnostics.

    config MICHI_DISPLAY_WAVE_ANIMATION
        bool "Enable low-rate Woven Wave activity animation"
        default y
        help
          Decorative motion shown only while the receiver plays or buffers.
          The waveform is NOT audio amplitude, seek position, or a visual
          confirmation of an actual PCM stream. Disable it during bench tests
          if SPI refresh causes underruns or excessive display CPU usage.

    config MICHI_DISPLAY_WAVE_PERIOD_MS
        int "Woven Wave refresh period (milliseconds)"
        default 160
        range 120 500
        depends on MICHI_DISPLAY_WAVE_ANIMATION
        help
          Minimum delay between animation-only redraws. Higher values reduce
          LCD bus traffic; the session observer remains event-driven.

    config MICHI_DISPLAY_RASTER_2BIT
        bool "Enable 2-bit anti-aliased raster mode"
        default n
        help
          Enable 2-bit AA raster mode. Requires regenerating assets with --raster 2bit. Disabled by default pending hardware display validation.

    comment "WARNING: MICHI_DISPLAY_RASTER_2BIT=y requires regenerating assets with --raster 2bit"
        depends on MICHI_DISPLAY_RASTER_2BIT

endmenu
```

## firmware/components/michi_led/Kconfig
```kconfig
menu "Michi Music Stream LED"

    config MICHI_LED_COUNT
        int "Number of SK6812 status LEDs"
        default 3
        range 1 64
        help
          LEDs on the M5Stack U003 status board (phase 7). The cat-contour
          strip is NOT supported (project restriction: no second channel).

    config MICHI_LED_MAX_BRIGHTNESS_PCT
        int "Maximum LED brightness (percent)"
        default 25
        range 1 100
        help
          Global brightness cap applied to EVERY pixel in software (all
          colors are scaled by this/100 in the animation task, never in
          hardware). SK6812 at full brightness is blinding in a dark room;
          the 25% default keeps the status LEDs visible but comfortable.
          Raise only if the LEDs are meant to be seen from a distance.

    config MICHI_LED_TASK_STACK_BYTES
        int "LED animation task stack (bytes)"
        default 3072
        range 2048 16384
        help
          Stack of the LED animation task (ESP-IDF xTaskCreate takes bytes).
          The task only computes pixel colors from the precomputed sine LUT
          and calls led_strip_set_pixel/refresh per tick, so the default is
          generous.

endmenu
```
