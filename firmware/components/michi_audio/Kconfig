## firmware/components/michi_wifi/Kconfig
```kconfig
menu "Michi Music Stream WiFi"

    comment "Wi-Fi STA with LAB-ONLY BLE provisioning (phase 9). Credentials live ONLY in the NVS 'wifi' namespace - nothing here is a Wi-Fi credential."

    config MICHI_WIFI_REQUIRE_WPA2
        bool "Require WPA2 or stronger AP authentication (recommended in production)"
        default n
        help
          When enabled, reject open and WPA-only access points during
          station association. Requires a WPA2/WPA3 capable AP. Default
          remains off to preserve existing factory deployments and lab
          networks; release engineering should enable it for deployments
          where the Wi-Fi infrastructure supports WPA2 or better.
          This protects Wi-Fi association only. It does NOT encrypt RTP
          itself or replace Michi Home authentication/OTA verification.

    config MICHI_WIFI_RETRY_MAX
        int "Max reconnect attempts before RECOVERABLE_ERROR"
        default 3
        range 0 10
        help
          Consecutive STA disconnects tolerated before the FSM lands on
          RECOVERABLE_ERROR (MICHI_EVENT_ERROR is broadcast with
          ESP_ERR_WIFI_NOT_CONNECT as data; recovery through USB Ecosystem
          reconfiguration or a reboot). 0 fails
          on the first disconnect.

    config MICHI_WIFI_RECONNECT_BASE_MS
        int "Reconnect backoff base (ms)"
        default 5000
        range 1000 60000
        help
          Backoff delay = BASE * 2^attempt, capped at 5 minutes, scheduled
          on a one-shot esp_timer (P0-11: never from the esp_event
          handler). With the defaults: 5 s, 10 s, 20 s, then
          RECOVERABLE_ERROR.

    config MICHI_WIFI_ALLOW_BLE_PROVISIONING_LAB
        bool "Enable BLE Wi-Fi provisioning (LAB ONLY, never production)"
        default n
        help
          Production firmware must use Michi Ecosystem USB factory
          provisioning with embedded Wi-Fi/Home identity. Disabling this
          leaves unprovisioned units waiting for USB recovery and prevents
          automatic BLE advertising. Lab builds require a unique long PoP.

    config MICHI_PROV_POP
        string "BLE provisioning proof-of-possession (SRP6a)"
        default ""
        help
          Proof-of-possession shown by the client (e.g. the Espressif
          Provisioning app) when starting the secure session. THIS IS A
          SHARED SECRET COMPILED INTO THE FIRMWARE: change it before any
          production deployment - a factory default PoP lets anyone on
          BLE range provision the device. It is a Kconfig STRING by
          design (the provisioning protocol needs it before the device is
          on the network); Wi-Fi credentials themselves are NEVER
          compiled in - they live only in NVS.

    config MICHI_PROV_SERVICE_NAME_PREFIX
        string "BLE provisioning service name prefix"
        default "MICHI-PROV_"
        help
          The provisioning BLE advertisement is
          <prefix><last 4 hex digits of the STA MAC> (e.g.
          MICHI-PROV_4CAB). Keep prefix + 4 characters within 31 bytes
          (BLE name limit); longer names are truncated by the BLE stack.

    config MICHI_PROV_RETRY_MS
        int "Automatic provisioning retry delay (ms)"
        default 30000
        range 5000 300000
        help
          After a failed provisioning session (10-min client timeout,
          bring-up error or NVS persist failure) the BLE provisioning
          service restarts automatically after this delay, max 3 retries.
          Exhausted sessions log clearly and land on UNPROVISIONED; the
          lab-only recovery trigger may restart the cycle; production devices
          use authorized USB Ecosystem recovery.

    config MICHI_WIFI_TASK_STACK_BYTES
        int "Provisioning task stack (bytes)"
        default 6144
        range 4096 16384
        help
          Stack of the task that brings up the BLE provisioning service
          (wifi_prov_mgr + protocomm + cJSON device-info endpoint) and
          persists the delivered credentials. The BLE bring-up blocks
          this task, never the esp_event handlers (P0-11).

endmenu
```

## firmware/main/Kconfig.projbuild
```kconfig
menu "Michi Music Stream Hardware"

    config MICHI_DEVICE_ID
        string "Device ID announced by the michi-link API"
        default "michi-receiver-1"
        help
          Unique identifier of this unit, announced as device_id by
          /api/v1/receiver/info and /api/v1/receiver/firmware (phase 4).
          Change it per unit before pairing/registration (phase 10).

    config MICHI_DAC_I2C_SDA
        int "External DAC I2C SDA pin"
        default 21
        help
          Camera SCCB SDA pin; the camera interface is not populated on this unit,
          reusing it forfeits the camera. REQUIRES physical validation: measure
          continuity between the DAC SDA line and GPIO21.

    config MICHI_DAC_I2C_SCL
        int "External DAC I2C SCL pin"
        default 16
        help
          Camera SCCB SCL pin; the camera interface is not populated on this unit,
          reusing it forfeits the camera. REQUIRES physical validation: measure
          continuity between the DAC SCL line and GPIO16.

    config MICHI_DAC_I2C_SPEED_HZ
        int "External DAC I2C bus speed (Hz)"
        default 100000
        help
          I2C clock for the external DAC bus. Default is 100 kHz: the ESP32-S3
          internal pull-ups (~45 kOhm) are marginal at 400 kHz, so 400000 is
          only safe after measuring external pull-ups (2.2-4.7 kOhm) on SDA/SCL
          - see README hardware validation.

    config MICHI_I2S_BCLK
        int "External DAC I2S BCLK pin"
        default 3
        help
          I2S bit clock to the external DAC. Default 3 is a free GPIO with no
          Waveshare ESP32-S3-LCD-2 collision. REQUIRES physical validation: measure
          continuity between the DAC BCLK line and GPIO3 on your unit. Measure with
          the unit powered off. Note: this is an ESP32-S3 strapping pin; the external
          circuit must not hold it low during reset.

    config MICHI_I2S_LRCK
        int "External DAC I2S LRCK pin"
        default 18
        help
          I2S left/right clock to the external DAC. Default 18 is a free GPIO with
          no Waveshare ESP32-S3-LCD-2 collision. REQUIRES physical validation:
          measure continuity between the DAC LRCK line and GPIO18 on your unit.
          Measure with the unit powered off.

    config MICHI_I2S_DIN
        int "External DAC I2S DIN pin"
        default 5
        help
          I2S serial data to the external DAC. Default 5 is a free GPIO with no
          Waveshare ESP32-S3-LCD-2 collision. REQUIRES physical validation: measure
          continuity between the DAC DIN line and GPIO5 on your unit. Measure with
          the unit powered off.

    config MICHI_I2S_MCLK
        int "External DAC I2S MCLK pin"
        default -1
        help
          GPIO46 is input-only on ESP32-S3 so MCLK cannot be driven; the PCM5122
          PLL synthesizes clocks from BCK/LRCK. Set to -1 to disable.

    config MICHI_DAC_MOCK
        bool "Register the mock DAC driver (tests/CI only)"
        default n
        help
          When enabled, the michi_dac registry also contains a "mock" driver
          whose probe outcome is controlled by MICHI_DAC_MOCK_PROBE_OK. Never
          enabled by default: it exists so tests/CI of later phases can
          exercise the DAC state machine without real hardware.

    config MICHI_DAC_MOCK_PROBE_OK
        bool "Mock DAC probe reports OK"
        default y
        depends on MICHI_DAC_MOCK
        help
          y: mock probe succeeds and the mock DAC binds during autodetection.
          n: mock probe fails, simulating an absent DAC.

    config MICHI_LED_GPIO
        int "External LED (SK6812) data pin"
        default 4
        help
          Camera HREF pin; camera interface not populated, reuse forfeits the
          camera. REQUIRES physical validation: measure continuity between the
          SK6812 data line and GPIO4.

    config MICHI_BUTTON_GPIO
        int "External pairing button pin"
        default 17
        help
          Camera PWDN pin; camera interface not populated, reuse forfeits the
          camera. Active low to GND, requires a pull-up. REQUIRES physical
          validation.

endmenu
```
