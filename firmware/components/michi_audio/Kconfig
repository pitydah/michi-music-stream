## firmware/components/michi_log/Kconfig
```kconfig
menu "Michi Music Stream Log"

    config MICHI_LOG_TAIL_SIZE_KB
        int "Tail ring buffer size (KB, PSRAM)"
        default 128
        range 16 1024
        help
          Size of the volatile log tail ring allocated from PSRAM at boot
          (the FIRST PSRAM allocation, so the address is deterministic
          across boots of the same build - the crash dump relies on it).
          Ring capacity is size/512 entries (512-byte slots; log payloads
          longer than 504 bytes are truncated in the tail only, the
          console is not). 128 KB = 255 entries.

    config MICHI_LOG_JOURNAL_MAX_KB
        int "Journal file max size (KB, SPIFFS)"
        default 256
        range 16 2048
        help
          Rotation threshold of journal.1: when it grows past this size it
          is renamed to journal.2 (the oldest file is dropped). Storage
          consumption is bounded by files * max (2 * 256 KB by default) on
          the SPIFFS "storage" partition (~8.25 MB).

    config MICHI_LOG_JOURNAL_FILES
        int "Journal files (rotation chain)"
        default 2
        range 1 4
        help
          Number of journal files in the rotation chain. 1 = single file
          that is truncated on rotation (no history); 2 = one generation
          of history; higher = more history at more SPIFFS space.

    config MICHI_LOG_CRASH_DUMP_KB
        int "Crash dump size (KB)"
        default 8
        range 2 64
        help
          How much of the previous boot's tail is copied to
          /spiffs/logs/crash_<boot_seq_prev>.txt after a crash reset
          (PANIC/INT_WDT/TASK_WDT/WDT) with a valid ring magic. Skipped
          (never invented) when the magic does not match. The dump keeps
          the NEWEST lines that fit: the ones just before the crash are
          the most valuable.

    config MICHI_LOG_CRASH_DUMP_KEEP
        int "Crash dumps kept on SPIFFS"
        default 4
        range 1 16
        help
          Number of crash_<seq>.txt files retained on the storage
          partition. When a new dump is written, the oldest dumps beyond
          this cap are deleted (the seq in the name orders them: highest
          seq = newest dump). Bounds the storage consumed by crash dumps
          to KEEP x max file size.

    config MICHI_LOG_QUEUE_LEN
        int "Journal event queue length"
        default 16
        range 4 256
        help
          Depth of the FreeRTOS queue between the FSM observer and the
          journal task. A full queue drops the event (counted, logged on
          the next drop). State changes and errors are rare (tens per
          day), so 16 is generous for a teardown storm.

    config MICHI_LOG_TAIL_MAX_ENTRIES_RESPONSE
        int "Maximum tail entries per /logs response"
        default 200
        range 50 500
        help
          Hard cap for the count query parameter of GET
          /api/v1/receiver/logs (handler default 100). Bounds the
          response size (each entry renders to at most ~519 bytes). The
          range is capped at 500: default 200; larger values spike
          internal-RAM cJSON usage (~130 KB at 200, ~1 MB at 2000) on
          top of the PSRAM entry buffers.

    config MICHI_LOG_TASK_STACK_BYTES
        int "Journal task stack (bytes)"
        default 4096
        range 2048 16384
        help
          Stack of the journal task (SPIFFS open/append/close + rotation
          per event). The default is generous for the FILE* + snprintf
          frames.

endmenu
```

## firmware/components/michi_ota/Kconfig
```kconfig
menu "Michi OTA"

config MICHI_OTA_MANIFEST_MAX_BYTES
    int "Maximum signed manifest size in bytes"
    default 2048
    range 1024 2048
    help
        Upper bound for the signed update manifest JSON downloaded from the
        manifest URL. The buffer lives on the HEAP (not the task stack);
        this bound is capped at 2048 so the heap spend stays small and the
        relation to the OTA task stack (MICHI_OTA_STACK_BYTES) stays
        predictable: the stack only carries mbedTLS + HTTP frames.
        Manifests larger than the bound are rejected at fetch time (the
        JSON content may be up to one byte less than this bound, which
        reserves the NUL terminator).

config MICHI_OTA_URL_MAX
    int "Maximum manifest URL length in characters"
    default 256
    range 64 1024
    help
        Upper bound for the manifest URL accepted by michi_ota_start() and
        for the binary URL inside the manifest. Longer URLs are rejected
        with ESP_ERR_INVALID_ARG.

config MICHI_OTA_HTTP_TIMEOUT_MS
    int "HTTP timeout for manifest fetch and firmware download (ms)"
    default 10000
    range 1000 60000
    help
        Per-read timeout for the esp_http_client during the manifest fetch
        and the firmware download. The download aborts cleanly on read
        failure (esp_ota_abort); there are no read retries.

config MICHI_OTA_STACK_BYTES
    int "OTA task stack size in bytes"
    default 10240
    range 4096 16384
    help
        Stack for the OTA task: it runs the whole update pipeline
        (manifest fetch, mbedTLS verification, streaming download,
        runtime SHA-256). The large transfer buffers (manifest up to
        MICHI_OTA_MANIFEST_MAX_BYTES, 4 KB download chunk) are
        heap-allocated, so the stack only has to carry mbedTLS + HTTP
        frames; 10240 leaves headroom for those frames.

endmenu
```

## firmware/components/michi_pairing/Kconfig
```kconfig
menu "Michi Music Stream Pairing"

    comment "Receiver-button pairing (MS-06): the window opens ONLY from the physical button; tokens are stored as SHA-256 digests (never plaintext). PIN attempts and rate limits are fixed contract constants in michi_pairing.h."

    config MICHI_PAIRING_WINDOW_SECONDS
        int "Pairing window duration (s)"
        default 120
        range 5 3600
        help
          How long a pairing window (opened by the physical button)
          stays open before it expires and closes itself (one-shot
          esp_timer -> MICHI_EVENT_PAIRING_WINDOW_CLOSED, PAIRING -> IDLE
          in the FSM). Monotonic clock. A reboot always closes it (the
          window is not persisted); re-opening replaces the previous
          window and drops pending pairing sessions. The default is 5 s:
          the physical button is the only window opener (no network-visible
          trigger), so a short window is a safe default - a press not
          followed by a controller pairing expires quickly instead of
          leaving the device discoverable for minutes.

    config MICHI_PAIRING_MAX_CONTROLLERS
        int "Maximum paired controllers"
        default 8
        range 1 16
        help
          Maximum registry entries persisted in the NVS "michi_pairing"
          namespace (one versioned blob). Reaching the limit rejects new
          confirmations until a controller is revoked.

endmenu
```

## firmware/components/michi_sd/Kconfig
```kconfig
menu "Michi SD"

config MICHI_SD_ENABLE
    bool "Enable microSD support (onboard card on the LCD SPI bus)"
    default y
    help
        Mounts the onboard microSD on the SPI bus shared with the LCD
        (CS 41, SPI2_HOST, same SCLK/MOSI/MISO as the display) and
        enables local OTA from the card (see michi_ota_start_local /
        michi_ota_check_local). The card is FAT, mounted at /sdcard.
        Without a card the system degrades gracefully: updates fall back
        to HTTPS OTA. The ESP32-S3 does NOT boot from SD - the card is
        update transport only.

config MICHI_SD_UPDATE_FILE
    string "Local update binary file name (on the SD card)"
    default "michi-update.bin"
    depends on MICHI_SD_ENABLE
    help
        Base file name of the firmware binary the receiver applies from
        the card. It must match the file:// base name inside the signed
        manifest (sign_manifest.py --url file://<this-name>), otherwise
        the update is rejected at validation. Keep it a plain name: no
        path separators, no ".." (the firmware enforces this).

config MICHI_SD_UPDATE_MANIFEST
    string "Local update manifest file name (on the SD card)"
    default "michi-update.json"
    depends on MICHI_SD_ENABLE
    help
        Base file name of the signed update manifest the receiver looks
        for on the card at /sdcard/<this-name>. The manifest is the SAME
        signed JSON used for HTTPS OTA (version/board/min_version/url/
        sha256/signature), signed with the same key; only the url scheme
        differs (file://<binary base name>).

config MICHI_SD_MOUNT_WAIT_MS
    int "Max wait for the async SD mount (ms)"
    default 3000
    range 100 10000
    help
        The SD mount runs in a task (michi_sd_init returns immediately).
        The boot-time local OTA check (michi_ota_check_local) waits up to
        this long for the mount flag before deciding there is no card.
        The mount usually completes in a few hundred ms while the rest
        of the boot runs in parallel (DAC/WiFi), so this is a safety
        bound, not a boot delay. Kept independent of MICHI_SD_ENABLE so
        michi_sd.c compiles unchanged when the SD support is compiled
        out of app_main/diagnostics (review F13).

config MICHI_SD_INFO_TTL_MS
    int "SD volume info cache TTL (ms)"
    default 30000
    range 1000 600000
    help
        michi_sd_get_info() performs the real esp_vfs_fat_info() SD I/O
        once and serves cached total/free bytes for this long. The
        diagnostics endpoint polls /diagnostics on demand; the TTL keeps
        the card quiet between polls. Kept independent of MICHI_SD_ENABLE
        so michi_sd.c compiles unchanged when the SD support is compiled
        out of app_main/diagnostics (review F13).

endmenu
```

## firmware/components/michi_state/Kconfig
```kconfig
menu "Michi Music Stream State"

    config MICHI_STATE_QUEUE_LEN
        int "Event queue length (events)"
        default 16
        range 4 256
        help
          Depth of the FreeRTOS queue between producers (post/post_from_isr/
          request) and the FSM task. Events dropped while the queue is full
          return ESP_ERR_TIMEOUT to the producer and are counted: the FSM
          task logs the accumulated count periodically, and task-context
          producers log their own drop. Keep the value high enough for the
          busiest burst (e.g. a session teardown storm in phase 12).

    config MICHI_STATE_TASK_STACK_BYTES
        int "State machine task stack (bytes)"
        default 4096
        range 2048 16384
        help
          Stack of the FSM task (ESP-IDF xTaskCreate takes bytes). The task
          only receives, logs and dispatches, so the default is generous;
          raise it only if a future observer grows the dispatch frame.

    config MICHI_STATE_MAX_OBSERVERS
        int "Maximum event observers"
        default 8
        range 1 32
        help
          Capacity of the observer table (one per registered (filter, fn)
          pair). Phase consumers: display (6), LED (7), network (9), audio
          (11), API (12). Registration beyond the limit fails with
          ESP_ERR_NO_MEM.

endmenu
```

## firmware/components/michi_time/Kconfig
```kconfig
menu "Michi Music Stream Time"

    comment "SNTP wall clock for signed discovery (P0-02): the signed announce carries a timestamp that Michi Link rejects outside +-90 s. Requires CONFIG_LWIP_SNTP=y (set in sdkconfig.defaults)."

    config MICHI_TIME_SNTP_SERVER
        string "SNTP server hostname"
        default "pool.ntp.org"
        help
          NTP server used by the esp_netif SNTP client (one server,
          the standard public pool). Nothing sensitive - the firmware
          only queries it.

    config MICHI_TIME_SYNC_TIMEOUT_MS
        int "SNTP sync wait timeout per attempt (ms)"
        default 10000
        range 1000 60000
        help
          Bound of ONE esp_netif_sntp_sync_wait round in the dedicated
          sync task. The wait never runs on the esp_event task: GOT_IP
          handlers stay non-blocking (P0-11). On timeout the task
          restarts the SNTP client and retries (see
          MICHI_TIME_SYNC_RETRIES).

    config MICHI_TIME_SYNC_RETRIES
        int "SNTP sync attempts per network up"
        default 2
        range 1 10
        help
          How many bounded sync_wait rounds the sync task runs after
          each network-up before giving up for that round. Exhaustion
          conserves the last synchronized state (documented policy in
          michi_time.h) - it never flips a previously synchronized
          device back to unsynchronized.

    config MICHI_TIME_TASK_STACK_BYTES
        int "Time sync task stack (bytes)"
        default 3072
        range 2048 8192
        help
          Stack of the "michi_time_sync" task (priority 2). It blocks
          on semaphores almost forever and only runs the bounded
          sync_wait rounds plus a few flag stores per sync event.

endmenu
```
